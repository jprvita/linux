## drivers/amlogic/Kconfig
```kconfig
#
# Amlogic driver configuration
#
menuconfig AML_VENDOR_DRIVERS
	bool "Amlogic device drivers"
	help
	  This menu contains device drivers provided by Amlogic.

if AML_VENDOR_DRIVERS
source "drivers/amlogic/bluetooth/Kconfig"
endif # AML_VENDOR_DRIVERS
```

## drivers/amlogic/bluetooth/Kconfig
```kconfig
menu "Bluetooth Device Support"
    depends on AML_VENDOR_DRIVERS
    depends on BT

config AML_BT_RFKILL
    bool "Bluetooth RFKill support"
    depends on RFKILL
    select BACKLIGHT_CLASS_DEVICE
    default n
    help
      Say Y here if you want to use the BT device.

endmenu
```
